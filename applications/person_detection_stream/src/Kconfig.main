## applications/person_detection_stream/src/Kconfig.main
```kconfig
#
# Copyright (c) 2026 Nordic Semiconductor ASA
#
# SPDX-License-Identifier: LicenseRef-Nordic-5-Clause
#

menu "Main"

config APP_MAIN_WATCHDOG_TIMEOUT_SECONDS
	int "Watchdog timeout"
	default 30
	help
	  The module only publishes requests in its handlers and never blocks.

config APP_MAIN_MSG_PROCESSING_TIMEOUT_SECONDS
	int "Maximum message processing time"
	default 5

config APP_MAIN_SWITCH_TIMEOUT_SECONDS
	int "Interface switch timeout"
	default 180
	help
	  How long "network use <iface>" waits for the new interface to come up before
	  it gives up and keeps streaming over the current one. LTE attach can take
	  tens of seconds.

module = APP_MAIN
module-str = Main
source "subsys/logging/Kconfig.template.log_config"

endmenu
```

## applications/person_detection_stream/src/lib/detector/Kconfig.detector
```kconfig
#
# Copyright (c) 2026 Nordic Semiconductor ASA
#
# SPDX-License-Identifier: LicenseRef-Nordic-5-Clause
#

menuconfig APP_DETECTOR
	bool "Person detection on the Axon NPU"
	default y
	depends on NRF_AXON
	help
	  Runs the sdk-edge-ai person_det model on RGB565 images fed to it,
	  with the JPEG decoder that produces them.

if APP_DETECTOR

config APP_DETECTOR_MAX_BOXES
	int "Most detections reported per frame"
	default 8

config APP_DETECTOR_MIN_SCORE
	int "Default detection threshold (percent)"
	range 0 100
	default 50
	help
	  Boxes scoring below this are dropped, until a threshold is stored with
	  `detect confidence`. It cannot go below SCORE_THRESHOLD.

# Read by the sdk-edge-ai person_detection postprocessing; the floor of the runtime threshold.
config SCORE_THRESHOLD
	int "Detection score floor (per mille)"
	range 0 1000
	default 100

config IOU_THRESHOLD
	int "Non-maximum suppression IoU threshold (per mille)"
	range 0 1000
	default 450

module = APP_DETECTOR
module-str = Detector
source "subsys/logging/Kconfig.template.log_config"

endif
```

## applications/person_detection_stream/src/lib/frame_pool/Kconfig.frame_pool
```kconfig
#
# Copyright (c) 2026 Nordic Semiconductor ASA
#
# SPDX-License-Identifier: LicenseRef-Nordic-5-Clause
#

menuconfig APP_FRAME_POOL
	bool "Frame chunk pool"
	default y
	help
	  Datagram-sized buffers through which the camera and detection modules
	  hand frame slices to the stream module, outside zbus.

if APP_FRAME_POOL

config APP_FRAME_POOL_CHUNK_COUNT
	int "Frame chunk buffers"
	default 4

endif
```

## applications/person_detection_stream/src/modules/camera/Kconfig.camera
```kconfig
#
# Copyright (c) 2026 Nordic Semiconductor ASA
#
# SPDX-License-Identifier: LicenseRef-Nordic-5-Clause
#

menuconfig APP_CAMERA
	bool "Arducam Mega camera"
	default y
	depends on APP_FRAME_POOL
	depends on DT_HAS_NORDIC_ARDUCAM_MEGA_ENABLED
	depends on SETTINGS
	select SPI
	select VIDEO
	help
	  Captures JPEG frames encoded by an Arducam Mega SPI camera, streams
	  them as they are and offers each one to the detection module.

if APP_CAMERA

config APP_CAMERA_SHELL
	bool "camera shell command"
	default y if SHELL

config APP_CAMERA_FPS_LIMIT
	int "Default frame rate limit"
	range 0 APP_CAMERA_FPS_MAX
	default 0
	help
	  Frames streamed per second until one is stored with `camera fps`.
	  0 is `camera fps max`: every frame the camera delivers.

config APP_CAMERA_FPS_MAX
	int "Highest frame rate limit accepted"
	default 30

config APP_CAMERA_WIDTH
	int "Frame width"
	default 320

config APP_CAMERA_HEIGHT
	int "Frame height"
	default 240

config APP_CAMERA_JPEG_QUALITY
	int "Camera JPEG quality (0 high, 1 default, 2 low)"
	range 0 2
	default 2
	help
	  The modem link bounds the stream, so smaller frames give a higher
	  frame rate.

config APP_CAMERA_HIGH_WIDTH
	int "High profile frame width"
	default 0
	help
	  Frame size used over a fast link such as Wi-Fi. 0 leaves only the
	  CONFIG_APP_CAMERA_WIDTH x HEIGHT profile. Raise
	  CONFIG_APP_CAMERA_BUFFER_SIZE and CONFIG_APP_DETECTION_SLOT_SIZE to fit.

config APP_CAMERA_HIGH_HEIGHT
	int "High profile frame height"
	default 0

config APP_CAMERA_HIGH_JPEG_QUALITY
	int "High profile JPEG quality (0 high, 1 default, 2 low)"
	range 0 2
	default 1

config APP_CAMERA_BUFFER_COUNT
	int "Video buffers"
	range 3 8
	default 3
	help
	  At most two are held by this module, so the driver always has one to
	  capture into.

config APP_CAMERA_BUFFER_SIZE
	int "Video buffer size (bytes)"
	default 16384
	help
	  Holds one JPEG frame. Larger frames are dropped as invalid; raise it
	  for the higher JPEG qualities.

config APP_CAMERA_THREAD_STACK_SIZE
	int "Capture thread stack size"
	default 2048

config APP_CAMERA_PROCESS_THREAD_STACK_SIZE
	int "Processing thread stack size"
	default 2048
	help
	  Slices frames into chunks.

config APP_CAMERA_WATCHDOG_TIMEOUT_SECONDS
	int "Watchdog timeout"
	default 60

config APP_CAMERA_STATS_INTERVAL_SECONDS
	int "Statistics log interval (seconds)"
	default 10

module = APP_CAMERA
module-str = Camera
source "subsys/logging/Kconfig.template.log_config"

endif

# Sized for APP_CAMERA_BUFFER_COUNT x APP_CAMERA_BUFFER_SIZE plus allocator overhead.
config VIDEO_BUFFER_POOL_HEAP_SIZE
	default 50176 if APP_CAMERA

config VIDEO_BUFFER_POOL_NUM_MAX
	default 3 if APP_CAMERA
```

## applications/person_detection_stream/src/modules/detection/Kconfig.detection
```kconfig
#
# Copyright (c) 2026 Nordic Semiconductor ASA
#
# SPDX-License-Identifier: LicenseRef-Nordic-5-Clause
#

menuconfig APP_DETECTION
	bool "Person detection module"
	default y
	depends on APP_DETECTOR
	depends on APP_CAMERA
	depends on APP_FRAME_POOL
	depends on SETTINGS
	help
	  Takes a copy of the newest camera JPEG whenever it is idle, decodes it
	  at the scale that fits the model and runs the detector in its own thread, so detection
	  never holds back the stream. Boxes follow their frame on the stream.

if APP_DETECTION

config APP_DETECTION_SHELL
	bool "detect shell command"
	default y if SHELL

config APP_DETECTION_FPS
	int "Default detection rate"
	range 0 APP_DETECTION_FPS_MAX
	default 0
	help
	  Detections per second until one is stored with `detect fps`. 0 is
	  `detect fps max`: as fast as the decoder and the NPU keep up.

config APP_DETECTION_FPS_MAX
	int "Highest detection rate accepted"
	default 30

config APP_DETECTION_SLOT_SIZE
	int "Frame slot size (bytes)"
	default 12288
	help
	  Holds the copy of the JPEG being detected. Larger frames are skipped.

config APP_DETECTION_THREAD_STACK_SIZE
	int "Thread stack size"
	default 4096
	help
	  Runs JPEG decoding and inference.

config APP_DETECTION_WATCHDOG_TIMEOUT_SECONDS
	int "Watchdog timeout"
	default 60

config APP_DETECTION_STATS_INTERVAL_SECONDS
	int "Statistics log interval (seconds)"
	default 10

module = APP_DETECTION
module-str = Detection
source "subsys/logging/Kconfig.template.log_config"

endif
```

## applications/person_detection_stream/src/modules/network/Kconfig.network
```kconfig
#
# Copyright (c) 2026 Nordic Semiconductor ASA
#
# SPDX-License-Identifier: LicenseRef-Nordic-5-Clause
#

menuconfig APP_NETWORK
	bool "Network module"
	default y
	depends on NET_CONNECTION_MANAGER
	help
	  Drives connectivity through conn_mgr / net_mgmt. The cellular modem driver
	  brings the PPP link up, and Wi-Fi connects to stored credentials where the
	  board has it. The first interface to reach L4 becomes the default route; a
	  failing interface is logged without stopping the others.

if APP_NETWORK

config APP_NETWORK_THREAD_STACK_SIZE
	int "Thread stack size"
	default 2048

config APP_NETWORK_WATCHDOG_TIMEOUT_SECONDS
	int "Watchdog timeout"
	default 300

config APP_NETWORK_MSG_PROCESSING_TIMEOUT_SECONDS
	int "Maximum message processing time"
	default 290

config APP_NETWORK_SEARCH_NETWORK_ON_STARTUP
	bool "Connect to network on startup"
	default y

config APP_NETWORK_MODEM_BAUDRATE
	int "Modem UART baud rate override"
	default 0
	depends on MODEM_CELLULAR
	help
	  Applied to the modem's UART before the cellular driver starts. 0 keeps
	  current-speed from devicetree. The nRF UARTE binding does not list
	  3000000, the only nRF93M1 rate above 921600, so it is set here.

config APP_NETWORK_LTE_RECOVERY_SECONDS
	int "LTE recovery timeout"
	default 120
	depends on MODEM_CELLULAR
	help
	  Time LTE gets to come up before the modem is power cycled. Further LTE
	  requests wait until the current one has completed or timed out.

module = APP_NETWORK
module-str = Network
source "subsys/logging/Kconfig.template.log_config"

endif
```

## applications/person_detection_stream/src/modules/stream/Kconfig.stream
```kconfig
#
# Copyright (c) 2026 Nordic Semiconductor ASA
#
# SPDX-License-Identifier: LicenseRef-Nordic-5-Clause
#

menuconfig APP_STREAM
	bool "UDP stream module"
	default y
	depends on NET_SOCKETS
	depends on NET_UDP
	depends on SETTINGS
	depends on APP_FRAME_POOL
	select NET_CONTEXT_SNDTIMEO
	help
	  Sends frame chunks as datagrams to a UDP endpoint.
	  Main tells it when the network is up; the user starts, stops and
	  points it from the shell.

if APP_STREAM

config APP_STREAM_SHELL
	bool "stream shell command"
	default y if SHELL

config APP_STREAM_HOST
	string "Default endpoint host name or IPv4 address"
	default ""
	help
	  Used until an endpoint is stored with `stream endpoint <host> [port]`.

config APP_STREAM_PORT
	int "Default endpoint UDP port"
	range 1 65535
	default 5005

config APP_STREAM_DATAGRAM_SIZE
	int "Datagram size in bytes, header included"
	range 64 1400
	default 1200
	help
	  Kept below the PPP MTU so the IP layer never fragments.

config APP_STREAM_SEND_TIMEOUT_MS
	int "Socket send timeout (ms)"
	default 1000
	help
	  Bounds how long a send may block when the network buffers are exhausted.
	  A timed-out datagram is counted as dropped.

config APP_STREAM_STATS_INTERVAL_SECONDS
	int "Statistics log interval (seconds)"
	default 5

config APP_STREAM_THREAD_STACK_SIZE
	int "Thread stack size"
	default 3072

config APP_STREAM_WATCHDOG_TIMEOUT_SECONDS
	int "Watchdog timeout"
	default 60

module = APP_STREAM
module-str = Stream
source "subsys/logging/Kconfig.template.log_config"

endif
```
